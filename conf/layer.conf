## conf/layer.conf
```bitbake
BBPATH .= ":${LAYERDIR}"

BBFILES += "${LAYERDIR}/recipes-*/*/*.bb \
            ${LAYERDIR}/recipes-*/*/*.bbappend"

BBFILE_COLLECTIONS += "balena-acst-bsp"
BBFILE_PATTERN_acst-bsp := "^${LAYERDIR}/"
BBFILE_PRIORITY_acst-bsp = "1337"

LAYERSERIES_COMPAT_acst-bsp = "pyro rocko sumo thud warrior dunfell"
```
